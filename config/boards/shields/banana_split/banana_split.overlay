/*
 * Copyright (c) 2022 Dan Bostian
 * SPDX-License-Identifier: MIT
 */

#include <dt-bindings/zmk/matrix_transform.h>

/ {
    chosen {
        zmk,kscan = &kscan0;
		zmk,matrix_transform = &default_transform;
    };

	default_transform: keymap_transform_0 {
		compatible = "zmk,matrix-transform";
		columns = <4>;
		rows = <2>;

		map = <
			RC(0,0) RC(1,0) RC(0,1) RC(1,1)         RC(0,2) RC(1,2) RC(0,3) RC(1,3)
		>;
	};

	kscan0: kscan_0 {
		compatible = "zmk,kscan-gpio-matrix";
		label = "KSCAN";
		diode-direction = "col2row";

		col-gpios
			= <&pro_micro 4 GPIO_ACTIVE_HIGH>
			, <&pro_micro 5 GPIO_ACTIVE_HIGH>
			, <&pro_micro 6 GPIO_ACTIVE_HIGH>
			, <&pro_micro 7 GPIO_ACTIVE_HIGH>
			;
		
		row-gpios
			= <&pro_micro 8 (GPIO_ACTIVE_HIGH | GPIO_PULL_DOWN)>
			, <&pro_micro 9 (GPIO_ACTIVE_HIGH | GPIO_PULL_DOWN)>
			;
	};
};
