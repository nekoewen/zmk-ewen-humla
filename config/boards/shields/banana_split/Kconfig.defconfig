## config/boards/shields/banana_split/Kconfig.defconfig
```kconfig
# Copyright (c) 2022 Dan Bostian
# SPDX-License-Identifier: MIT

if SHIELD_BANANA_SPLIT

config ZMK_KEYBOARD_NAME
	default "Banana Split"

endif
```

## config/boards/shields/banana_split/Kconfig.shield
```kconfig
# Copyright (c) 2022 Dan Bostian
# SPDX-License-Identifier: MIT

config SHIELD_BANANA_SPLIT
	def_bool $(shields_list_contains,banana_split)
```

## config/boards/shields/humla/Kconfig.defconfig
```kconfig
# Copyright (c) 2020 The ZMK Contributors
# SPDX-License-Identifier: MIT

if SHIELD_HUMLA

config ZMK_KEYBOARD_NAME
    default "Humla"

endif
```

## config/boards/shields/humla/Kconfig.shield
```kconfig
# Copyright (c) 2020 The ZMK Contributors
# SPDX-License-Identifier: MIT

config SHIELD_HUMLA
    def_bool $(shields_list_contains,humla)
```
